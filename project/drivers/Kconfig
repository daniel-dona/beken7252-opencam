## project/drivers/Kconfig
```kconfig
menu "Hardware Drivers Config"

config BEKEN_USING_UART1
    bool "Using UART 1"
    select RT_USING_SERIAL
    default n

config BEKEN_USING_UART2
    bool "Using UART 2"
    select RT_USING_SERIAL
    default n

config BEKEN_USING_WDT
    bool "Using WDT"
    select RT_USING_WDT
    default n

config BEKEN_USING_IIC
    bool "Using IIC"
    select RT_USING_I2C
    select RT_USING_I2C_BITOPS
    default n

config BEKEN_USING_FLASH
    bool "Using Flash"
    default n

config BEKEN_USING_PWM
    bool "Using PWM"
    default n

config BEKEN_USING_GPIO
    bool "Using GPIO" 
    select RT_USING_PIN
    default n

config BEKEN_USING_WLAN
    bool "Using Wi-Fi"
    select RT_USING_WIFI
    default n

    if BEKEN_USING_WLAN
        config LWIP_NETIF_HOSTNAME
        int
        default 1

        config BEKEN_USING_WLAN_STA
        bool "Enable Station"
        select RT_USING_WLAN_STA
        default y

        config BEKEN_USING_WLAN_AP
        bool "Enable Soft_AP"
        select RT_USING_WLAN_AP
        default n
    endif

config BEKEN_USING_AUDIO
    bool "Using Audio"
    default n

config BEKEN_USING_SPI
    bool "Using SPI"
    select RT_USING_SPI
    default n
    
    if BEKEN_USING_SPI
        config BEKEN_USING_SPI_FLASH
        bool "Using SPI Flash"
        select RT_USING_SFUD
        default n
    endif

config RT_USING_CPU_FFS
    bool "Using CPU FFS"
    default n

config RT_MAIN_THREAD_STACK_SIZE
    int "Set main thread stack size"
    default 2048

config BEKEN_USING_AUTO_POWERSAVE
    bool "Enable Auto PowerSave"
    default n

endmenu
```

## project/samples/Kconfig
```kconfig
menu "Application Samples Config"

    config RT_USING_AIRKISS
        bool "Enable Airkiss"
        default n

source "$BSP_DIR/samples/rtcloud/Kconfig"
source "$BSP_DIR/samples/peripheral/Kconfig"
source "$BSP_DIR/samples/OTA/Kconfig"
source "$BSP_DIR/samples/webnet/Kconfig"
#source "$BSP_DIR/samples/record/Kconfig"
endmenu
```

## project/samples/ayla/Kconfig
```kconfig
config PKG_USING_AYLA_SDK
    bool
    default n    

config SAMPLE_USING_AYLA_CLOUD
    bool "Enable ayla cloud sample"
    default n
    select PKG_USING_AYLA_SDK
    help
        Using Ayla cloud sample.

if SAMPLE_USING_AYLA_CLOUD
    config AYLA_USING_RT_OTA
        bool "Using rt_ota function"
        default n
        select PKG_USING_FAL
        help
            Using rt_ota function.

endif        
```

## project/samples/ota/Kconfig
```kconfig
menu "RT-Thread OTA Samples"

    config SAMPLE_USING_OTA_YMODEM
        bool "Ymodme OTA mode"
        default n
        select RT_USING_RYM
        select PKG_USING_FAL
        help
            Using Ymodme mode to update device firmware by UART.

    config SAMPLE_USING_OTA_HTTP
        bool "HTTP OTA mode"
        default n
        select PKG_USING_WEBCLIENT
        select PKG_USING_FAL
        help
            Using http mode to update device firmware by net.

endmenu
```

## project/samples/peripheral/Kconfig
```kconfig
menu "Peripheral Samples Config"
    config SAMPLE_USING_GPIO_SAMPLE
        bool "Enable GPIO Sample"
        default n
    
    config SAMPLE_USING_UART_SAMPLE
        bool "Enable UART Sample"
        default n

    config SAMPLE_USING_I2C_SAMPLE
        bool "Enable I2C Sample"
        default n
endmenu
```

## project/samples/rtcloud/Kconfig
```kconfig
config SAMPLE_USING_CLOUDSDK
    bool "Enable rt-thread cloudsdk sample"
    default n
    select PKG_USING_CLOUDSDK
    help
        A rtcloud example for keken7231 board.

config PKG_USING_CLOUDSDK
    bool "CloudSDK: RT_thread IOT CloudSDK"
    default n
    select PKG_USING_PAHOMQTT
    select PKG_USING_CJSON

if PKG_USING_CLOUDSDK
    config CLD_PRODUCT_ID
        string "Device Product ID"
        default "5ab146f774e74002"

    config CLD_PRODUCT_KEY
        string "Device Product KEY"
        default "6e1ef4a2-0ed8-4326-a248-28432350f656"

    config CLD_USING_DEFAULT_INFO
        bool "Device using default information and ignore activate"
        default n

    config CLD_USING_SHELL
        bool "Enable Web Shell"
        default n   
    config CLD_USING_LOG
        bool "Enable Web Log"
        default n

    config CLD_USING_OTA
        bool "Enable OTA"
        default y
        select PKG_USING_WEBCLIENT
        select PKG_USING_TINYCRYPT
        select PKG_USING_RT_OTA
        select PKG_USING_EASYFLASH      
endif
```

## project/samples/webnet/Kconfig
```kconfig
config SAMPLE_USING_WEBNET
    bool "Enable webnet http server "
    default n
    select PKG_USING_WEBNET
    select PKG_USING_CJSON
    help
        A http server example for keken7231 board.
```
